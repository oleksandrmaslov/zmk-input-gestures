## compile_tests/config/boards/shields/ble/Kconfig.defconfig
```kconfig
if SHIELD_BLE01_RIGHT || SHIELD_BLE02_LEFT

config ZMK_SPLIT_ROLE_CENTRAL
    default y

endif

if SHIELD_BLE01_LEFT || SHIELD_BLE01_RIGHT
config ZMK_SPLIT
    default y

config ZMK_KEYBOARD_NAME
    default "ble01"

config ZMK_POINTING
    default y


config I2C
    default n

config SPI
    default y

endif

if SHIELD_BLE02_LEFT || SHIELD_BLE02_RIGHT
config ZMK_SPLIT
    default y

config ZMK_KEYBOARD_NAME
    default "ble02"

config ZMK_POINTING
    default y

config I2C
    default n

config SPI
    default y

endif
```

## compile_tests/config/boards/shields/ble/Kconfig.shield
```kconfig
config SHIELD_BLE01_LEFT
    def_bool $(shields_list_contains,ble01_left)

# No whitespace after the comma or in your part name!
config SHIELD_BLE01_RIGHT
    def_bool $(shields_list_contains,ble01_right)

config SHIELD_BLE02_LEFT
    def_bool $(shields_list_contains,ble02_left)

# No whitespace after the comma or in your part name!
config SHIELD_BLE02_RIGHT
    def_bool $(shields_list_contains,ble02_right)
```

## compile_tests/config/boards/shields/usbonly/Kconfig.defconfig
```kconfig
if SHIELD_USBONLY01_RIGHT || SHIELD_USBONLY02_LEFT

config ZMK_SPLIT_ROLE_CENTRAL
    default y

endif

if SHIELD_USBONLY01_LEFT || SHIELD_USBONLY01_RIGHT
config ZMK_SPLIT
    default y

config ZMK_KEYBOARD_NAME
    default "UsbOnly01"

config ZMK_POINTING
    default y


config I2C
    default y

endif

if SHIELD_USBONLY02_LEFT || SHIELD_USBONLY02_RIGHT
config ZMK_SPLIT
    default y

config ZMK_KEYBOARD_NAME
    default "UsbOnly02"

config ZMK_POINTING
    default y


config I2C
    default y

endif
```

## compile_tests/config/boards/shields/usbonly/Kconfig.shield
```kconfig
config SHIELD_USBONLY01_LEFT
    def_bool $(shields_list_contains,usbonly01_left)

# No whitespace after the comma or in your part name!
config SHIELD_USBONLY01_RIGHT
    def_bool $(shields_list_contains,usbonly01_right)

config SHIELD_USBONLY02_LEFT
    def_bool $(shields_list_contains,usbonly02_left)

# No whitespace after the comma or in your part name!
config SHIELD_USBONLY02_RIGHT
    def_bool $(shields_list_contains,usbonly02_right)
```

## compile_tests/config/west.yml
```yaml
manifest:
  remotes:
    - name: zmkfirmware
      url-base: https://github.com/zmkfirmware
    - name: halfdane
      url-base: https://github.com/halfdane/
    - name: johanson
      url-base: https://github.com/petejohanson
  projects:
    - name: zmk
      remote: johanson
      revision: split/wired-split-first-pass
      import: app/west.yml
    - name: cirque-input-module
      remote: halfdane
      revision: absolute_mode
    - name: zmk-input-processors
      remote: halfdane
      revision: main
    - name: zmk-input-gestures
      remote: halfdane
      revision: main
    - name: zephyr
      remote: johanson
      revision: v3.5.0+zmk-fixes+rp2040-uart-fifo
      clone-depth: 1
      import:
        name-blocklist:
          - ci-tools
          - hal_altera
          - hal_cypress
          - hal_infineon
          - hal_microchip
          - hal_nxp
          - hal_openisa
          - hal_silabs
          - hal_xtensa
          - hal_st
          - hal_ti
          - loramac-node
          - mcuboot
          - mcumgr
          - net-tools
          - openthread
          - edtt
          - trusted-firmware-m
  self: 
    path: config
```

## drivers/input/Kconfig
```kconfig
# Copyright (c) 2022 The ZMK Contributors
# SPDX-License-Identifier: MIT


DT_COMPAT_ZMK_INPUT_PROCESSOR_GESTURES := zmk,input-processor-gestures

if ZMK_POINTING

config ZMK_INPUT_PROCESSOR_GESTURES
		bool
		default $(dt_compat_enabled,$(DT_COMPAT_ZMK_INPUT_PROCESSOR_GESTURES))

config INPUT_GESTURES_INIT_PRIORITY
    int "Touchpad gestures initialization priority"
    default INPUT_INIT_PRIORITY

endif # ZMK_POINTING
```

## dts/bindings/zmk,input-processor-gestures.yaml
```yaml
# Copyright (c) 2021 The ZMK Contributors
# SPDX-License-Identifier: MIT

description: Several gestures for touchpads

compatible: "zmk,input-processor-gestures"

include: ip_zero_param.yaml

properties:
  tap-detection:
    type: boolean
    description: |
      A touch that doesn't last longer than tap-timout-ms is interpreted as a tap (click).
  tap-timout-ms:
    type: int
    default: 120
    description: |
      A lower value requires a quicker tap motion, but reduces accidental taps for short movements. 
      The default value is a good compromise that works for me.
  prevent_movement_during_tap:
    type: boolean
    description: |
      While determining if the beginning of a touch is a tap, ignore all other movements.
      This prevents accidental movement aways from the tap-target, but it makes the 
      beginning of regular touches more sluggish.
  
  inertial-cursor:
    type: boolean
    description: |
      If the cursor moves faster than inertial-cursor-velocity-threshold-ms when the touch ends, the cursor 
      keeps moving in  the same direction, gradually getting slower by inertial-cursor-decay-percent.
  inertial-cursor-velocity-threshold:
    type: int
    default: 10
    description: |
      A lower value makes it easier to activate the inertial, but increases the accidental activation.
      The default value is a good compromise that works for me.
  inertial-cursor-decay-percent:
    type: int
    default: 5
    description: |
      A lower value will make the cursor move longer after the touch ends - kinda like changing the friction that
      slows down the cursor.
      The default value mimics a relatively high friction.
    
  circular-scroll:
    type: boolean
    description: |
      If a touch begins on the outer circular-scroll-rim-percent percentage of the touchpad, angular
      movement of the touch is interpreted as scrolling down (clockwise) or up (counter-clockwise).
  circular-scroll-rim-percent:
    type: int
    default: 10
    description: |
      Width of the outer ring of the touchpad that activates circular scroll when the touch starts there.
      A lower value reduces accicental activation during normal usage, but requires better targeting
      to activate.
      The default value is a good compromise that works for me.
  circular-scroll-width:
    type: int
    default: 1024
    description: |
      Width of the touchpad.
  circular-scroll-height:
    type: int
    default: 1024
    description: |
      Height of the touchpad.
    
  right-side-vertical-scroll:
    type: boolean
    description: |
      If a touch begins on the right right-side-vertical-scroll-percent percentage of the touchpad, vertical
      movement of the touch is interpreted as vertical scrolling.
  right-side-vertical-scroll-percent:
    type: int
    default: 10
    description: |
      Width of the right part of the touchpad that activates vertical scroll when the touch starts there.
      A lower value reduces accicental activation during normal usage, but requires better targeting
      to activate.
      The default value is a good compromise that works for me.
    
  top-side-horizontal-scroll:
    type: boolean
    description: |
      If a touch begins on the top top-side-horizontal-scroll-percent percentage of the touchpad, horizontal
      movement of the touch is interpreted as horizontal scrolling
  top-side-horizontal-scroll-percent:
    type: int
    default: 10
    description: |
      Height of the upper part of the touchpad that activates horizontal scroll when the touch starts there.
      A lower value reduces accicental activation during normal usage, but requires better targeting
      to activate.
      The default value is a good compromise that works for me.

  wait-for-new-position-ms:
    type: int
    default: 30
    description: |
      The time it takes the touchpad to generate a new position in normal usage.
      Lower values result in better detection when a touch ends, but might trigger accidental
      taps or other gesture if a new position gets reported after the wait-for-new-position-ms 
      while the current touch is ongoing.
      Since Cirque Glidepoint touchpads report around every 10 ms, and some overhead to account
      for intense usage, the default value allows reliable tap detection while being quick enough that
      I can't notice it.
```

## src/Kconfig
```kconfig
# Copyright (c) 2022 The ZMK Contributors
# SPDX-License-Identifier: MIT

DT_COMPAT_ZMK_INPUT_PROCESSOR_GESTURES := zmk,input-processor-gestures

config ZMK_INPUT_PROCESSOR_GESTURES
		bool
		default $(dt_compat_enabled,$(DT_COMPAT_ZMK_INPUT_PROCESSOR_GESTURES))
        depends on ZMK_POINTING
        depends on (!ZMK_SPLIT || ZMK_SPLIT_ROLE_CENTRAL)

config INPUT_GESTURES_INIT_PRIORITY
    int "Touchpad gestures initialization priority"
    default INPUT_INIT_PRIORITY
    depends on ZMK_INPUT_PROCESSOR_GESTURES
```
