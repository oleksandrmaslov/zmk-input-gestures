#include <behaviors.dtsi>
#include <dt-bindings/zmk/keys.h>
#include <dt-bindings/zmk/bt.h>
#include <dt-bindings/zmk/outputs.h>


/ {
  keymap {
    compatible = "zmk,keymap";
    LOL {
      display-name = "lol";
      bindings = < &bootloader >;
    };
  };
};

